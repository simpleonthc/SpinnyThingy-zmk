/ {
    chosen {
        zmk,kscan = &kscan;
    };

    kscan: kscan {
        compatible = "zmk,kscan-gpio-direct";
        label = "KSCAN";
        input-gpios = 
            <&pro_micro 7 (GPIO_ACTIVE_LOW | GPIO_PULL_UP)>,
            <&pro_micro 8 (GPIO_ACTIVE_LOW | GPIO_PULL_UP)>,
            <&pro_micro 9 (GPIO_ACTIVE_LOW | GPIO_PULL_UP)>;
    };
};